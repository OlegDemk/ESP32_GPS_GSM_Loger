## 2. Main GPS loger project/main/Kconfig.projbuild
```kconfig
menu "Example Configuration"

    orsource "$IDF_PATH/examples/common_components/env_caps/$IDF_TARGET/Kconfig.env_caps"
	
	config ESP_WIFI_SSID
		string "WiFI SSID"
		default "myssid"
		help
		SSID (network name) for example to connect to.
			
	config ESP_WIFI_PASSWORD
		string "WiFi Password"
		default "mypassword"
		help
		WiFi password (WPA or WPA2) for the example to use.		
	
	choice WIFI_SCAN_METHOD
   	 	prompt "WiFi Scan Method"
   		default WIFI_SCAN_METHOD_ALL_CHANNEL
    	help
        	WiFi scan method:
 
       		If "Fast" is selected, scan will end after find SSID match AP.
 
        	If "All Channel" is selected, scan will end after scan all the channel.
 
    config WIFI_SCAN_METHOD_FAST
        bool "Fast"
    config WIFI_SCAN_METHOD_ALL_CHANNEL
        bool "All Channel"
	endchoice
 
	choice WIFI_CONNECT_AP_SORT_METHOD
		prompt "WiFi Connect AP Sort Method"
		default WIFI_CONNECT_AP_BY_SIGNAL
		help
			WiFi connect AP sort method:
 
			If "Signal" is selected, Sort matched APs in scan list by RSSI.
 
			If "Security" is selected, Sort matched APs in scan list by security mode.
 
		config WIFI_CONNECT_AP_BY_SIGNAL
			bool "Signal"
		config WIFI_CONNECT_AP_BY_SECURITY
			bool "Security"
	endchoice
 
	config WIFI_SCAN_RSSI_THRESHOLD
		int "WiFi minimum rssi"
		range -127 0
 
		default -127
		help
			The minimum rssi to accept in the scan mode.
 
	choice WIFI_SCAN_AUTH_MODE_THRESHOLD
		prompt "WiFi Scan auth mode threshold"
		default WIFI_AUTH_OPEN
		help
			The weakest authmode to accept in the scan mode.
 
		config WIFI_AUTH_OPEN
			bool "OPEN"
		config WIFI_AUTH_WEP
			bool "WEP"
		config WIFI_AUTH_WPA_PSK
			bool "WPA PSK"
		config WIFI_AUTH_WPA2_PSK
			bool "WPA2 PSK"
		config WIFI_AUTH_WPA_WPA2_PSK
			bool "WPA WPA2 PSK"
		config WIFI_AUTH_WPA2_ENTERPRISE
			bool "WPA2 ENTERPRISE"
		config WIFI_AUTH_WPA3_PSK
			bool "WPA3 PSK"
		config WIFI_AUTH_WPA2_WPA3_PSK
			bool "WPA2 WPA3 PSK"
		config WIFI_AUTH_WAPI_PSK
			bool "WAPI PSK"
	endchoice
	
	config SERVER_IP
   		string "SERVER IPV4 Address"
    	default "192.168.1.16"
    	help
        	SERVER IPV4 Address.
 
	config SERVER_PORT
    	int "Server Port"
    	range 0 65535
    	default 3333
    	help
        	The remote port.
 
	config CLIENT_PORT
    	int "Client Port"
    	range 0 65535
    	default 4444
    	help
        	The local port.	
endmenu

menu "GPIO Configuration"	            
   	config RED_GPIO
   		int "LED RED GPIO number"
    	range 0 48
    	default 18
    	help
    		RED GPIO.
    		
  	config GREEN_GPIO
    	int "LED GREEN GPIO number"
    	range 0 48
    	default 25
    	help
    		GREEN GPIO.		
 
	config BLUE_GPIO
    	int "LED BLUE GPIO number"
    	range 0 48
    	default 33
    	help
    		BLUE GPIO. 
endmenu

menu "I2C Configuration"
	config SDA_GPIO
		int "SDA GPIO number"
		range 0 48
		default 21
		help 
			GPIO number SDA.
			
	config SCL_GPIO
		int "SCL GPIO number"
		range 0 48
		default 22
		help 
			GPIO number SCL.
endmenu

menu "HTTP file_serving example menu"
    config EXAMPLE_MOUNT_SD_CARD
        bool "Use SD card for file storage"
        default n
        help
            If this config item is set, the file you upload to server can be chosen to save in the SDcard.

    config EXAMPLE_FORMAT_IF_MOUNT_SDCARD_FAILED
        bool "Format the card if mount failed"
        default n
        depends on EXAMPLE_MOUNT_SD_CARD
        help
            If this config item is set, the card will be formatted if mount has failed.

    config EXAMPLE_USE_SDMMC_HOST
        bool "Use SDMMC host"
        default y
        depends on EXAMPLE_MOUNT_SD_CARD && SOC_SDMMC_HOST_SUPPORTED
        help
            If this config item is set, SDMMC is used to mount the SDcard.
            Otherwise, will use SPI host to access and mount the SDcard.

    menu "SD card pin configuration (SPI)"
        depends on EXAMPLE_MOUNT_SD_CARD && !EXAMPLE_USE_SDMMC_HOST

        config EXAMPLE_PIN_MOSI
            int "MOSI GPIO number"
            default 23 if IDF_TARGET_ESP32
            default 35 if IDF_TARGET_ESP32S2
            default 35 if IDF_TARGET_ESP32S3
            default 4  # C3 and others

        config EXAMPLE_PIN_MISO
            int "MISO GPIO number"
            default 19 if IDF_TARGET_ESP32
            default 37 if IDF_TARGET_ESP32S2
            default 37 if IDF_TARGET_ESP32S3
            default 6  # C3 and others

        config EXAMPLE_PIN_CLK
            int "CLK GPIO number"
            default 14 if IDF_TARGET_ESP32
            default 36 if IDF_TARGET_ESP32S2
            default 36 if IDF_TARGET_ESP32S3
            default 5  # C3 and others

        config EXAMPLE_PIN_CS
            int "CS GPIO number"
            default 13 if IDF_TARGET_ESP32
            default 34 if IDF_TARGET_ESP32S2
            default 34 if IDF_TARGET_ESP32S3
            default 1  # C3 and others

    endmenu

    menu "SD card pin configuration (SDMMC)"
        depends on EXAMPLE_USE_SDMMC_HOST && SOC_SDMMC_USE_GPIO_MATRIX

        config EXAMPLE_PIN_CMD
            int "CMD GPIO number"
            default 35 if IDF_TARGET_ESP32S3
            default 1

        config EXAMPLE_PIN_CLK
            int "CLK GPIO number"
            default 36 if IDF_TARGET_ESP32S3
            default 2

        config EXAMPLE_PIN_D0
            int "D0 GPIO number"
            default 37 if IDF_TARGET_ESP32S3
            default 3

        config EXAMPLE_PIN_D1
            int "D1 GPIO number"
            default 38 if IDF_TARGET_ESP32S3
            default 4

        config EXAMPLE_PIN_D2
            int "D2 GPIO number"
            default 33 if IDF_TARGET_ESP32S3
            default 5

        config EXAMPLE_PIN_D3
            int "D3 GPIO number"
            default 34 if IDF_TARGET_ESP32S3
            default 6

    endmenu

    config EXAMPLE_HTTPD_CONN_CLOSE_HEADER
        bool "Send connection close header from request handlers"
        default y
        help
            If this config item is set, Connection: close header will be set in handlers.
            This closes HTTP connection and frees the server socket instantly.
endmenu

menu "GPS Configuration"
    orsource "$IDF_PATH/examples/common_components/env_caps/$IDF_TARGET/Kconfig.env_caps"

    config NMEA_PARSER_UART_RXD
        int "UART RXD pin number"
        range ENV_GPIO_RANGE_MIN ENV_GPIO_IN_RANGE_MAX
        default 16
        help
            GPIO number for UART RX pin. See UART documentation for more information
            about available pin numbers for UART.

    config NMEA_PARSER_RING_BUFFER_SIZE
        int "NMEA Parser Ring Buffer Size"
        range 0 2048
        default 1024
        help
            Size of the ring buffer used for UART Rx channel.

    config NMEA_PARSER_TASK_STACK_SIZE
        int "NMEA Parser Task Stack Size"
        range 0 4096
        default 3072
        help
            Stack size of NMEA Parser task.

    config NMEA_PARSER_TASK_PRIORITY
        int "NMEA Parser Task Priority"
        range 0 24
        default 2
        help
            Priority of NMEA Parser task.

    menu "NMEA Statement Support"
        comment "At least one statement must be selected"
        config NMEA_STATEMENT_GGA
            bool "GGA Statement"
            default y
            help
                Enabling this option will parse the following parameter from GGA statement:

                - Latitude, Longitude, Altitude;
                - Number of satellites in use, fix status (no fix, GPS, DGPS), UTC time;

        config NMEA_STATEMENT_GSA
            bool "GSA Statement"
            default y
            help
                Enabling this option will parse the following parameter from GSA statement:

                - Position/Vertical/Horizontal dilution of precision;
                - Fix mode (no fix, 2D, 3D fix);
                - IDs of satellites in use;

        config NMEA_STATEMENT_GSV
            bool "GSV Statement"
            default y
            help
                Enabling this option will parse the following parameter from GSV statement:

                - Number of satellites in view;
                - Optional details of each satellite in view;

        config NMEA_STATEMENT_RMC
            bool "RMC Statement"
            default y
            help
                Enabling this option will parse the following parameter from RMC statement:

                - Validity of GPS signal;
                - Ground speed (knots) and course over ground (degrees);
                - Magnetic variation;
                - UTC date;

        config NMEA_STATEMENT_GLL
            bool "GLL Statement"
            default y
            help
                Enabling this option will parse the following parameter from GLL statement:

                - Latitude, Longitude;
                - UTC time;

        config NMEA_STATEMENT_VTG
            bool "VTG Statement"
            default y
            help
                Enabling this option will parse the following parameter from VTG statement:

                - Ground speed (knots, km/h) and course over ground (degrees);
                - Magnetic variation;

    endmenu

	config POWER_GPS_GPIO
    int "Turn ON/OFF GPS module"
   	range 0 48
    default 26
    help
    	Turn ON/OFF GPS module.   
endmenu

menu "GSM Configuration"
  	config GSM_UART_RXD
        int "UART RXD pin number"
        default 5
        help
            GPIO number for UART RX pin. See UART documentation for more information
            about available pin numbers for UART.
            
	config GSM_UART_TXD
        int "UART TXD pin number"
        default 15
        help
            GPIO number for UART RX pin. See UART documentation for more information
            about available pin numbers for UART.        
            
    config POWER_GSM_GPIO
    	int "Turn ON/OFF GSM module"
   		range 0 48
   		default 27
    	help
    		Turn ON/OFF GSM module.                               
endmenu
```

## Parts projects/4. SIM800L/main/Kconfig.projbuild
```kconfig
menu "GPIO Configuration"
 	config BLINK_GPIO
        int "Blink GPIO number"
        default 5
        help
            GPIO number (IOxx) to blink on and off or the RMT signal for the addressable LED.
            Some GPIOs are used for other purposes (flash connections, etc.) and cannot be used to blink.
    		            
    config RED_GPIO
   		int "LED RED GPIO number"
    	range 0 48
    	default 18
    	help
    		RED GPIO.
    		
  	config GREEN_GPIO
    	int "LED GREEN GPIO number"
    	range 0 48
    	default 25
    	help
    		GREEN GPIO.		
 
	config BLUE_GPIO
    	int "LED BLUE GPIO number"
    	range 0 48
    	default 33
    	help
    		BLUE GPIO. 
endmenu

menu "GSM Configuration"
  	config GSM_UART_RXD
        int "UART RXD pin number"
        default 15
        help
            GPIO number for UART RX pin. See UART documentation for more information
            about available pin numbers for UART.
            
	config GSM_UART_TXD
        int "UART TXD pin number"
        default 5
        help
            GPIO number for UART RX pin. See UART documentation for more information
            about available pin numbers for UART.        
            
    config POWER_GSM_GPIO
    	int "Turn ON/OFF GSM module"
   		range 0 48
   		default 27
    	help
    		Turn ON/OFF GSM module.                               
endmenu
```

## Parts projects/6. Web server/1. Simple web server/main/Kconfig.projbuild
```kconfig
menu "GPIO Configuration"
 	config BLINK_GPIO
        int "Blink GPIO number"
        default 5
        help
            GPIO number (IOxx) to blink on and off or the RMT signal for the addressable LED.
            Some GPIOs are used for other purposes (flash connections, etc.) and cannot be used to blink.
    		            
    config RED_GPIO
   		int "LED RED GPIO number"
    	range 0 48
    	default 18
    	help
    		RED GPIO.
    		
  	config GREEN_GPIO
    	int "LED GREEN GPIO number"
    	range 0 48
    	default 25
    	help
    		GREEN GPIO.		
 
	config BLUE_GPIO
    	int "LED BLUE GPIO number"
    	range 0 48
    	default 33
    	help
    		BLUE GPIO. 
endmenu

menu "I2C Configuration"
	config SDA_GPIO
		int "SDA GPIO number"
		range 0 48
		default 21
		help 
			GPIO number SDA.
			
	config SCL_GPIO
		int "SCL GPIO number"
		range 0 48
		default 22
		help 
			GPIO number SCL.
endmenu

menu "WiFi"
	config ESP_WIFI_SSID
    		string "Wi-Fi SSID"
    		default "myssid"
    		help
        	SSID of the Wi-Fi network to which the ESP32 will connect.

	config ESP_WIFI_PASSWORD
    		string "Wi-Fi Password"
    		default "mypassword"
   		help
        		Password of the Wi-Fi network to which the ESP32 will connect.
endmenu
```
